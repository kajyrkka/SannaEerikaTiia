## BluetoohToPhoneAndAdc/build/BluetoohToPhoneAndAdc/Kconfig/Kconfig.shield
```kconfig
osource "C:/Users/kajyrkka/NordicSW/BluetoohToPhoneAndAdc/boards/shields/*/Kconfig.shield"
osource "C:/ncs/v2.7.0/nrf/boards/shields/*/Kconfig.shield"
```
